## config/west.yml
```yaml
manifest:
  remotes:
    - name: zmkfirmware
      url-base: https://github.com/zmkfirmware
    - name: ladihzey
      url-base: https://github.com/ladihzey
  projects:
    - name: zmk
      remote: zmkfirmware
      revision: main
      import: app/west.yml
    - name: nice-view-battery
      remote: ladihzey
      revision: main
  self:
    path: config
```
